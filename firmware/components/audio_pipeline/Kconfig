## firmware/components/audio_pipeline/Kconfig
```kconfig
menu "VoiceStick audio pipeline"

config VOICESTICK_AUDIO_SELF_TEST_ON_BOOT
    bool "Run audio input self-test on boot"
    default n
    help
        When enabled, firmware reads a short burst of board audio input after
        boot and logs basic PCM statistics. This is intended for bench testing
        new board ports and is disabled in normal builds.

endmenu
```

## firmware/components/voice_board/Kconfig
```kconfig
menu "VoiceStick board"

choice VOICESTICK_BOARD
    prompt "VoiceStick hardware board"
    default VOICESTICK_BOARD_STICK_S3

config VOICESTICK_BOARD_STICK_S3
    bool "M5Stack StickS3"
    depends on IDF_TARGET_ESP32S3

config VOICESTICK_BOARD_M5STICKC_PLUS
    bool "M5Stack M5StickC Plus"
    depends on IDF_TARGET_ESP32

endchoice

endmenu
```

## firmware/main/Kconfig
```kconfig
menu "VoiceStick app diagnostics"

config VOICESTICK_BUTTON_DIAGNOSTIC_ON_BOOT
    bool "Run raw button GPIO diagnostic on boot"
    default n
    help
        When enabled, firmware logs raw primary/secondary button level changes
        for a short period after boot. This is intended for bench testing new
        board ports and is disabled in normal builds.

config VOICESTICK_BLE_AUDIO_E2E_TEST_ON_BOOT
    bool "Run BLE audio end-to-end diagnostic on boot"
    default n
    help
        When enabled, firmware waits for the BLE central to subscribe to
        state and audio notifications, then simulates one short primary-button
        hold to exercise the normal recording and BLE audio path. This is
        intended for automated bench testing only and is disabled in normal
        builds.

endmenu
```
